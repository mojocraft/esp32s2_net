## build/Kconfig/Kconfig.shield
```kconfig
osource "/home/mojo/Projects/zephyr/esp32s2_net/boards/shields/*/Kconfig.shield"
```

## build/Kconfig/arch/Kconfig
```kconfig
# Load arch Kconfig descriptions.
osource "/home/mojo/zephyrproject/zephyr/arch/x86/Kconfig"
osource "/home/mojo/zephyrproject/zephyr/arch/xtensa/Kconfig"
osource "/home/mojo/zephyrproject/zephyr/arch/sparc/Kconfig"
osource "/home/mojo/zephyrproject/zephyr/arch/riscv/Kconfig"
osource "/home/mojo/zephyrproject/zephyr/arch/posix/Kconfig"
osource "/home/mojo/zephyrproject/zephyr/arch/nios2/Kconfig"
osource "/home/mojo/zephyrproject/zephyr/arch/mips/Kconfig"
osource "/home/mojo/zephyrproject/zephyr/arch/arm64/Kconfig"
osource "/home/mojo/zephyrproject/zephyr/arch/arm/Kconfig"
osource "/home/mojo/zephyrproject/zephyr/arch/arc/Kconfig"
```
